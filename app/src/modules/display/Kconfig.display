## app/src/modules/display/Kconfig.display
```kconfig
module = DISPLAY_MODULE
module-str = DISPLAY
source "subsys/logging/Kconfig.template.log_config"

if DISPLAY

if LVGL

config LV_Z_VDB_SIZE
	default 64

config LV_DPI_DEF
	default 148

config LV_Z_BITS_PER_PIXEL
	default 1

choice LV_COLOR_DEPTH
	default LV_COLOR_DEPTH_1
endchoice

endif # LVGL

endif # DISPLAY
```

## boards/waveshare/ros_driver/Kconfig.defconfig
```kconfig
# ROS Driver for Robots board configuration

if BOARD_ROS_DRIVER_ESP32_PROCPU

config HEAP_MEM_POOL_ADD_SIZE_BOARD
	int
	default 65535 if WIFI && BT
	default 51200 if WIFI
	default 40960 if BT
	default 4096

config DISK_DRIVER_SDMMC
	default y

endif # BOARD_ROS_DRIVER_ESP32_PROCPU

if BOARD_ROS_DRIVER_ESP32_APPCPU

config HEAP_MEM_POOL_ADD_SIZE_BOARD
	default 4096

endif # BOARD_ROS_DRIVER_ESP32_APPCPU
```
