## CMakeLists.txt
```
cmake_minimum_required(VERSION 3.20.0)

find_package(Zephyr REQUIRED HINTS $ENV{ZEPHYR_BASE})
project(ros_driver)

target_sources(app PRIVATE src/main.c)
add_subdirectory(src/common common)
add_subdirectory(src/modules/button button)
add_subdirectory(src/modules/display display)
add_subdirectory(src/modules/led led)
```

## Kconfig
```
menu "Application"

rsource "src/modules/button/Kconfig.button"
rsource "src/modules/display/Kconfig.display"
rsource "src/modules/led/Kconfig.led"

endmenu

menu "Zephyr Kernel"
source "Kconfig.zephyr"
endmenu
```

## sample.yaml
```
# This file is provided so that the application can be compiled using Twister,
# the Zephyr testing tool. In this file, multiple combinations can be specified,
# so that you can easily test all of them locally or in CI.
sample:
  description: ROS Driver application
  name: ros-driver 
common:
  build_only: true
  integration_platforms:
    - ros_driver
tests:
  app.default: {}
#  app.debug:
#    extra_overlay_confs:
#      - debug.conf
```

## prj.conf
```kconfig
CONFIG_MAIN_STACK_SIZE=4096

# Drivers
CONFIG_DISPLAY=y

# OLED Display
CONFIG_LVGL=y
CONFIG_LV_FONT_MONTSERRAT_48=y

# Logging
CONFIG_LOG=y

# ZBus
CONFIG_ZBUS=y

# Shell Testing
CONFIG_SHELL=y
```

## src/main.c
```c
#include <zephyr/zbus/zbus.h>

#include "message_channel.h"

#define LOG_LEVEL CONFIG_LOG_DEFAULT_LEVEL
#include <zephyr/logging/log.h>
LOG_MODULE_REGISTER(main);

/* Boot to State Standby */
// static enum sys_states sys_state = SYS_STANDBY;


// static void led_msg(enum sys_states msg)
// {
// 	int err;

// 	err = zbus_chan_pub(&led_ch, &msg, K_SECONDS(1));
// 	if (err) {
// 		LOG_ERR("zbus_chan_pub, error: %d", err);
// 	}
// }

// static void button_msg_cb(const struct zbus_channel *chan)
// {
// 	const enum sys_events *msg_type;

// 	/* Get message from channel. */
// 	msg_type = zbus_chan_const_msg(chan);

// 	if (*msg_type != SYS_BUTTON_PRESSED) {
// 		/* Ignore other messages */
// 		return;
// 	}

// 	/* Assign new system state */
// 	switch (sys_state) {
// 	case SYS_SLEEP:
// 		sys_state = SYS_STANDBY;
// 		LOG_INF("System state standby");
// 		break;
// 	case SYS_STANDBY:
// 		sys_state = SYS_SLEEP;
// 		LOG_INF("System state sleep");
// 		break;
// 	default:
// 		return;
// 		break;
// 	}

// 	led_msg(sys_state);
// }

int main(void)
{
	/* Notify the LED module about the initial system state */
	// led_msg(sys_state);

	return 0;
}

// ZBUS_LISTENER_DEFINE(button_test, button_msg_cb);
// ZBUS_CHAN_ADD_OBS(button_ch, button_test, DEFAULT_OBS_PRIO);
```
